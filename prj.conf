## CMakeLists.txt
```
#-------------------------------------------------------------------------------
# Zephyr Example Application
#
# Copyright (c) 2021 Nordic Semiconductor ASA
# SPDX-License-Identifier: Apache-2.0

cmake_minimum_required(VERSION 3.13.1)
find_package(Zephyr REQUIRED HINTS $ENV{ZEPHYR_BASE})

project(app LANGUAGES C)

target_sources(app PRIVATE src/main.c)

target_sources_ifdef(CONFIG_USR_FUN app PRIVATE src/usr_fun.c)
```

## Kconfig
```
mainmenu "Customized Menu Name"

menu "Application Options"
config USR_FUN
	bool "Enable usr_fun"
	default n
	help
	  Enables the usr_fun function.
endmenu

source "Kconfig.zephyr"
```

## west.yml
```
# Copyright (c) 2021 Nordic Semiconductor ASA
# SPDX-License-Identifier: Apache-2.0

manifest:
  self:
    west-commands: scripts/west-commands.yml

  remotes:
    - name: ncs
      url-base: https://github.com/nrfconnect
    - name: ncs-docker
      url-base: https://github.com/NordicPlayground


  projects:
    - name: nrf
      remote: ncs
      repo-path: sdk-nrf
      revision: v2.6.0
      import: true
    - name: ncs-docker
      remote: ncs-docker
      revision: saga
      repo-path: nrf-docker
```

## prj.conf
```kconfig
# The file is used for default builds (no CONF_FILE option used).
# It contains selected Kconfig options for the application.

CONFIG_PRINTK=y
```

## src/main.c
```c
/*
 * Copyright (c) 2021 Nordic Semiconductor ASA
 * SPDX-License-Identifier: Apache-2.0
 */

#include <zephyr/kernel.h>

int main(void)
{
	while (1) {
		printk("Hello, World!\n");
		k_sleep(K_MSEC(1000));
	}

	return 0;
}
```

## src/usr_fun.c
```c
#include "usr_fun.h"
#include <zephyr/kernel.h>

void usr_fun(void)
{
    printk("Message in a user function.\n");
}
```

## src/usr_fun.h
```c
#pragma once

void usr_fun(void);
```
